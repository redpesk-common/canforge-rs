VERSION ""

CM_ "Test comment in unexpected order";

NS_ :

BS_:

BO_ 641 Main: 8 Vector__XXX
 SG_ MyCode : 0|2@0+ (1,0) [0|3] "" Vector__XXX
 SG_ LengthWithCode : 2|2@0+ (0.5,0) [0|1.5] "" Vector__XXX

VAL_ 641 MyCode 0 "ZERO" 1 "ONE" 2 "TWO" 3 "THREE";

BO_ 642 Main2: 8 Vector__XXX
 SG_ MyCode : 0|2@0+ (1,0) [0|3] "" Vector__XXX
 SG_ LengthWithCode : 2|2@0+ (0.5,0) [0|1.5] "" Vector__XXX

CM_ "interlaced VAL_ sections"

VAL_ 642 MyCode 0 "ZERO2" 1 "ONE2" 2 "TWO2" 3 "THREE2";
